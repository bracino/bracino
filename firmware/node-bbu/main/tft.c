#include "tft.h"

#include <string.h>

#include "driver/gpio.h"
#include "driver/spi_master.h"
#include "esp_err.h"
#include "esp_lcd_panel_commands.h"
#include "esp_lcd_panel_io.h"
#include "esp_log.h"
#include "freertos/FreeRTOS.h"
#include "freertos/semphr.h"
#include "freertos/task.h"

#define TAG "tft"

/*
 * Green-tab 128x160 (MSP1803). Landscape MADCTL MY|MV|BGR (Adafruit rot 1).
 * window() flips X and Y so callers keep top-left origin + LTR text under MY.
 * XSTART 0 keeps 20x8 rows inside visible GRAM (XSTART 1 clipped a column).
 */
#define XSTART 0
#define YSTART 2
#define MADCTL_LAND  (LCD_CMD_MY_BIT | LCD_CMD_MV_BIT | LCD_CMD_BGR_BIT)

#define STRIP_H  16
#define SPI_HZ   (10 * 1000 * 1000)

/* Modern DOS 8x16 (Jayvee Enaguas) via susam/pcface — CC0-1.0 / MIT.
 * Row-major: 16 bytes/glyph, MSB = leftmost pixel. ASCII 0x20..0x7E. */
static const uint8_t FONT8X16[95][16] = {
    { 0x00, 0x00, 0x00, 0x00, 0x00, 0x00, 0x00, 0x00, 0x00, 0x00, 0x00, 0x00, 0x00, 0x00, 0x00, 0x00 }, /* U+0020 */
    { 0x00, 0x00, 0x18, 0x3c, 0x3c, 0x3c, 0x18, 0x18, 0x18, 0x00, 0x18, 0x18, 0x00, 0x00, 0x00, 0x00 }, /* U+0021 */
    { 0x00, 0x66, 0x66, 0x22, 0x22, 0x00, 0x00, 0x00, 0x00, 0x00, 0x00, 0x00, 0x00, 0x00, 0x00, 0x00 }, /* U+0022 */
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    { 0x00, 0x00, 0x76, 0xdc, 0x00, 0x00, 0x00, 0x00, 0x00, 0x00, 0x00, 0x00, 0x00, 0x00, 0x00, 0x00 }, /* U+007E */
};

static esp_lcd_panel_io_handle_t s_io;
static uint16_t s_strip[TFT_W * STRIP_H];
static uint16_t s_glyph[TFT_CHAR_W * TFT_CHAR_H];
/* esp_lcd DMA reads the color pointer after tx_color returns; recycle only
 * from on_color_trans_done. Without this wait, row redraws tear glyphs
 * (e.g. "27.9" → " 7.9") as the next char overwrites s_glyph mid-transfer. */
static SemaphoreHandle_t s_tx_done;

static uint16_t be16(uint16_t c)
{
    return (uint16_t)((c << 8) | (c >> 8));
}

static void cmd(int c)
{
    if (s_io) {
        esp_lcd_panel_io_tx_param(s_io, c, NULL, 0);
    }
}

static void cmd_data(int c, const uint8_t *d, size_t n)
{
    if (s_io) {
        esp_lcd_panel_io_tx_param(s_io, c, d, n);
    }
}

static void window(int x, int y, int w, int h)
{
    /* MY|MV landscape: flip both axes so callers keep top-left + LTR. */
    x = TFT_W - x - w;
    y = TFT_H - y - h;
    int x0 = x + XSTART;
    int x1 = x + w - 1 + XSTART;
    int y0 = y + YSTART;
    int y1 = y + h - 1 + YSTART;
    uint8_t caset[4] = {0, (uint8_t)x0, 0, (uint8_t)x1};
    uint8_t raset[4] = {0, (uint8_t)y0, 0, (uint8_t)y1};
    cmd_data(LCD_CMD_CASET, caset, 4);
    cmd_data(LCD_CMD_RASET, raset, 4);
}

static bool IRAM_ATTR color_done_cb(esp_lcd_panel_io_handle_t io,
                                    esp_lcd_panel_io_event_data_t *edata,
                                    void *user_ctx)
{
    (void)io;
    (void)edata;
    (void)user_ctx;
    BaseType_t hp = pdFALSE;
    if (s_tx_done) {
        xSemaphoreGiveFromISR(s_tx_done, &hp);
    }
    return hp == pdTRUE;
}

static void send_color(const uint16_t *buf, size_t nbytes)
{
    if (!s_io || nbytes == 0) {
        return;
    }
    /* Drop a stale done from a prior timeout so we wait for *this* transfer. */
    if (s_tx_done) {
        (void)xSemaphoreTake(s_tx_done, 0);
    }
    esp_err_t err = esp_lcd_panel_io_tx_color(s_io, LCD_CMD_RAMWR, buf, nbytes);
    if (err != ESP_OK) {
        ESP_LOGE(TAG, "tx_color %s", esp_err_to_name(err));
        return;
    }
    if (s_tx_done) {
        (void)xSemaphoreTake(s_tx_done, portMAX_DELAY);
    }
}

void tft_fill_rect(int x, int y, int w, int h, uint16_t color)
{
    if (!s_io || w <= 0 || h <= 0) {
        return;
    }
    if (x < 0) {
        w += x;
        x = 0;
    }
    if (y < 0) {
        h += y;
        y = 0;
    }
    if (x + w > TFT_W) {
        w = TFT_W - x;
    }
    if (y + h > TFT_H) {
        h = TFT_H - y;
    }
    if (w <= 0 || h <= 0) {
        return;
    }

    uint16_t px = be16(color);
    while (h > 0) {
        int rows = h < STRIP_H ? h : STRIP_H;
        int n = w * rows;
        window(x, y, w, rows);
        for (int i = 0; i < n; i++) {
            s_strip[i] = px;
        }
        send_color(s_strip, (size_t)n * 2);
        y += rows;
        h -= rows;
    }
}

void tft_fill(uint16_t color)
{
    tft_fill_rect(0, 0, TFT_W, TFT_H, color);
}

void tft_char(int x, int y, char c, uint16_t fg, uint16_t bg)
{
    if (!s_io) {
        return;
    }
    unsigned idx = (unsigned)(uint8_t)c;
    if (idx < 0x20 || idx > 0x7E) {
        idx = (unsigned)'?';
    }
    const uint8_t *g = FONT8X16[idx - 0x20];
    uint16_t fgbe = be16(fg);
    uint16_t bgbe = be16(bg);

    /* MY: first RAM write is visual bottom of the window → rows bottom-first.
     * X flip in window(): first RAM write is visual right → columns right-first.
     * g[0]/MSB = top-left of glyph. */
    for (int row = 0; row < TFT_CHAR_H; row++) {
        uint8_t bits = g[TFT_CHAR_H - 1 - row];
        for (int col = 0; col < TFT_CHAR_W; col++) {
            s_glyph[row * TFT_CHAR_W + (TFT_CHAR_W - 1 - col)] =
                (bits & (uint8_t)(0x80u >> col)) ? fgbe : bgbe;
        }
    }
    window(x, y, TFT_CHAR_W, TFT_CHAR_H);
    send_color(s_glyph, sizeof(s_glyph));
}

void tft_text(int x, int y, const char *s, uint16_t fg, uint16_t bg)
{
    while (*s && x <= TFT_W - TFT_CHAR_W) {
        tft_char(x, y, *s++, fg, bg);
        x += TFT_CHAR_W;
    }
}

void tft_text_row(int row, const char *s, uint16_t fg, uint16_t bg)
{
    char buf[TFT_COLS + 1];
    memset(buf, ' ', TFT_COLS);
    buf[TFT_COLS] = '\0';
    if (s) {
        size_t n = strlen(s);
        /* Leave col 0 blank; start text in col 1 (plenty of room on the right). */
        if (n > TFT_COLS - 1) {
            n = TFT_COLS - 1;
        }
        memcpy(buf + 1, s, n);
    }
    if (row < 0) {
        row = 0;
    }
    if (row >= TFT_ROWS) {
        row = TFT_ROWS - 1;
    }
    tft_text(TFT_TEXT_X, row * TFT_CHAR_H, buf, fg, bg);
}

static void hw_reset(void)
{
    gpio_config_t io = {
        .pin_bit_mask = 1ULL << TFT_PIN_RST,
        .mode = GPIO_MODE_OUTPUT,
        .pull_up_en = GPIO_PULLUP_DISABLE,
        .pull_down_en = GPIO_PULLDOWN_DISABLE,
        .intr_type = GPIO_INTR_DISABLE,
    };
    gpio_config(&io);
    gpio_set_level(TFT_PIN_RST, 1);
    vTaskDelay(pdMS_TO_TICKS(10));
    gpio_set_level(TFT_PIN_RST, 0);
    vTaskDelay(pdMS_TO_TICKS(20));
    gpio_set_level(TFT_PIN_RST, 1);
    vTaskDelay(pdMS_TO_TICKS(120));
}

static void panel_init_cmds(void)
{
    cmd(LCD_CMD_SWRESET);
    vTaskDelay(pdMS_TO_TICKS(150));
    cmd(LCD_CMD_SLPOUT);
    vTaskDelay(pdMS_TO_TICKS(150));

    const uint8_t frm1[] = {0x01, 0x2C, 0x2D};
    const uint8_t frm3[] = {0x01, 0x2C, 0x2D, 0x01, 0x2C, 0x2D};
    cmd_data(0xB1, frm1, sizeof(frm1));
    cmd_data(0xB2, frm1, sizeof(frm1));
    cmd_data(0xB3, frm3, sizeof(frm3));
    const uint8_t invctr = 0x07;
    cmd_data(0xB4, &invctr, 1);
    const uint8_t pw1[] = {0xA2, 0x02, 0x84};
    const uint8_t pw2 = 0xC5;
    const uint8_t pw3[] = {0x0A, 0x00};
    const uint8_t pw4[] = {0x8A, 0x2A};
    const uint8_t pw5[] = {0x8A, 0xEE};
    const uint8_t vm = 0x0E;
    cmd_data(0xC0, pw1, sizeof(pw1));
    cmd_data(0xC1, &pw2, 1);
    cmd_data(0xC2, pw3, sizeof(pw3));
    cmd_data(0xC3, pw4, sizeof(pw4));
    cmd_data(0xC4, pw5, sizeof(pw5));
    cmd_data(0xC5, &vm, 1);
    cmd(LCD_CMD_INVOFF);
    const uint8_t madctl = MADCTL_LAND;
    cmd_data(LCD_CMD_MADCTL, &madctl, 1);
    const uint8_t colmod = 0x05;
    cmd_data(LCD_CMD_COLMOD, &colmod, 1);
    static const uint8_t gp[] = {
        0x02, 0x1C, 0x07, 0x12, 0x37, 0x32, 0x29, 0x2D,
        0x29, 0x25, 0x2B, 0x39, 0x00, 0x01, 0x03, 0x10
    };
    static const uint8_t gn[] = {
        0x03, 0x1D, 0x07, 0x06, 0x2E, 0x2C, 0x29, 0x2D,
        0x2E, 0x2E, 0x37, 0x3F, 0x00, 0x00, 0x02, 0x10
    };
    cmd_data(0xE0, gp, sizeof(gp));
    cmd_data(0xE1, gn, sizeof(gn));
    cmd(LCD_CMD_NORON);
    vTaskDelay(pdMS_TO_TICKS(10));
    cmd(LCD_CMD_DISPON);
    vTaskDelay(pdMS_TO_TICKS(100));
}

void tft_init(void)
{
    spi_bus_config_t bus = {
        .sclk_io_num = TFT_PIN_SCK,
        .mosi_io_num = TFT_PIN_SDA,
        .miso_io_num = -1,
        .quadwp_io_num = -1,
        .quadhd_io_num = -1,
        .max_transfer_sz = TFT_W * STRIP_H * 2 + 8,
    };
    esp_err_t err = spi_bus_initialize(SPI2_HOST, &bus, SPI_DMA_CH_AUTO);
    if (err != ESP_OK) {
        ESP_LOGE(TAG, "spi bus %s", esp_err_to_name(err));
        return;
    }

    s_tx_done = xSemaphoreCreateBinary();
    if (!s_tx_done) {
        ESP_LOGE(TAG, "tx_done sem");
        return;
    }

    esp_lcd_panel_io_spi_config_t io_cfg = {
        .cs_gpio_num = -1,
        .dc_gpio_num = TFT_PIN_DC,
        .spi_mode = 0,
        .pclk_hz = SPI_HZ,
        /* Depth 1 + done-wait: single shared glyph/strip buffer is safe. */
        .trans_queue_depth = 1,
        .on_color_trans_done = color_done_cb,
        .user_ctx = NULL,
        .lcd_cmd_bits = 8,
        .lcd_param_bits = 8,
    };
    err = esp_lcd_new_panel_io_spi((esp_lcd_spi_bus_handle_t)SPI2_HOST,
                                   &io_cfg, &s_io);
    if (err != ESP_OK) {
        ESP_LOGE(TAG, "panel io %s", esp_err_to_name(err));
        s_io = NULL;
        return;
    }

    hw_reset();
    panel_init_cmds();
    tft_fill(COL_BG);
}
